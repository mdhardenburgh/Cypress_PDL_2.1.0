# S6E2DHxJ register map
Vendor: Cypress; File version: 2.1
S6E2DH Series package J
CPU: CM4 r0p1, little endian, MPU, FPU, 4 interrupt priority bits
Registers are 32-bit, read-write, reset 0x0 unless marked. A register's access mark holds for its fields unless they carry their own. Offsets are from the block's base; lines under a group give offsets from that group; [hi:lo] are bit positions; {n}, {i} and the like mark numbered series; 'fields as' and 'values as' point back to an identical list; <NAME> marks a mode.

## Memory map
0x40000000 FLASH_IF blocks up to offset 0x120 — Flash Memory
0x40000200 UNIQUE_ID blocks up to offset 0x8
0x40000300 ECC_CAPTURE size 0x4 — ECC Capture Address
0x40010000 CRG blocks up to offset 0x78 — Clock Unit Registers
0x40011000 HWWDT blocks up to offset 0xC04 — Hardware Watchdog Timer
0x40012000 SWWDT blocks up to offset 0xC04 — Software Watchdog Timer
0x40015000 DT blocks up to offset 0x3C — Dual Timer
0x40020000 MFT0 blocks up to offset 0x1ED — Multifunction Timer 0
0x40024000 MFT_PPG blocks up to offset 0x359 — PPG Configuration
0x40025000 BT0 blocks up to offset 0x12 — Base Timer 0
0x40025040 BT1 blocks up to offset 0x12 — Base Timer 1
0x40025080 BT2 blocks up to offset 0x12 — Base Timer 2
0x400250C0 BT3 blocks up to offset 0x12 — Base Timer 3
0x40025100 BTIOSEL03 blocks up to offset 0x2 — Base Timer I/O Select
0x40025200 BT4 blocks up to offset 0x12 — Base Timer 4
0x40025240 BT5 blocks up to offset 0x12 — Base Timer 5
0x40025280 BT6 blocks up to offset 0x12 — Base Timer 6
0x400252C0 BT7 blocks up to offset 0x12 — Base Timer 7
0x40025300 BTIOSEL47 blocks up to offset 0x2 — Base Timer I/O Select
0x40025F00 SBSSR blocks up to offset 0xFE — Software-based Simultaneous Startup Register
0x40026000 QPRC0 blocks up to offset 0x40 — Quadrature Position/Revolution Counter 0
0x40026100 QPRC0_NF blocks up to offset 0x9 — Quadrature Position/Revolution Counter 0 Noise Filter
0x40027000 ADC0 blocks up to offset 0x54 — ADC0 Registers
0x40027100 ADC1 blocks up to offset 0x54 — ADC1 Registers
0x4002E000 CRTRIM blocks up to offset 0x10 — CR Trimming Registers
0x40030000 EXTI blocks up to offset 0x1A — External Interrupt and NMI Control
0x40031000 INTREQ blocks up to offset 0x404 — Interrupts
0x40035000 LVD blocks up to offset 0x11 — Low-voltage Detection
0x40035100 DS blocks up to offset 0x810 — Low Power Consumption Mode
0x40036000 USBCLK blocks up to offset 0x35 — USB Clock
0x40037000 CANPRES size 0x1 — CAN Prescaler Register
{0x40038000+0x100*n} MFS{n} blocks up to offset 0x42 (n=0..7) — Multi-function Serial Interface {n}
0x40039000 CRC blocks up to offset 0x10 — CRC Registers
0x4003A000 WC blocks up to offset 0x15 — Watch Counter
0x4003B100 RTC blocks up to offset 0x180 — REAL-TIME CLOCK
0x4003C000 LSCRP size 0x1 — Low-speed CR Prescaler
0x4003C100 CLK_GATING blocks up to offset 0x28 — Peripheral Clock Gating
0x4003D000 I2SPRE blocks up to offset 0x38 — I2S Clock Generation
0x4003D100 GDCPRE blocks up to offset 0x31 — GDC Prescaler
0x4003F000 EXBUS blocks up to offset 0x314 — External Bus Interface
0x40040000 USB0 blocks up to offset 0x2176 — USB0 Function
0x40060000 DMAC blocks up to offset 0x90 — DMAC Registers
0x40061000 DSTC size 0xB0 — DSTC registers
0x4006C000 I2S0 size 0x30 — I2S
0x4006C800 I2S1 size 0x30 — I2S interface ch.1
0x4006E000 SDIF blocks up to offset 0x156 — SD Card Interface
0x4006F000 GPIO blocks up to offset 0x740
0x40070000 CANFD0 blocks up to offset 0x21C — CAN FD Registers
0x40080000 PCRC blocks up to offset 0x18 — 0
0xD0A00000 GDCSUB blocks up to offset 0x14C — GDC Subsystem control registers
0xD0A03000 SDRAMC blocks up to offset 0x114 — GDC Sub system SDRAM Controller
0xD0A04000 HSSPI blocks up to offset 0x405 — HI-SPEED SPI Controller
0xD0A05000 HYPERBUS blocks up to offset 0x4C — HyperBus Interface

## Interrupts
0 CSV (CRG)
1 SWDT (SWWDT)
2 LVD
{n} IRQ{n:03}SEL (INTREQ) (n=3..10)
{n+11} EXINT{n} (EXTI) (n=0..7)
19 QPRC0
21 MFT0_WFG_DTIF (MFT0)
24 MFT0_FRT_PEAK (MFT0)
25 MFT0_FRT_ZERO (MFT0)
26 MFT0_ICU (MFT0)
27 MFT0_OCU (MFT0)
36 PPG00_02_04 (MFT_PPG)
37 PPG08_10_12 (MFT_PPG)
38 PPG16_18_20 (MFT_PPG)
{n+39} BT{n} (n=0..7)
47 DT
48 WC
49 EXTBUS_ERR_GDC_SDRAM (EXBUS, SDRAMC)
50 RTC
{n+43} EXINT{n} (EXTI) (n=8..15)
59 TIM (CRG, I2SPRE)
{2n+60} MFS{n}_RX (MFS{n}) (n=0..7)
{2n+61} MFS{n}_TX (MFS{n}) (n=0..7)
76 ADC0
77 ADC1
78 USB0_F (USB0)
79 USB0_H_F (USB0)
81 CANFD0
{n+83} DMAC{n} (DMAC) (n=0..7)
91 DSTC
92 GDC_CMD_SEQ (GDCPRE)
93 GDC_BLT_ENG (GDCPRE)
94 GDC_DRW_ENG (GDCPRE)
95 GDC_CONT_STRM0 (GDCPRE)
96 GDC_SAFE_STRM0 (GDCPRE)
97 GDC_DISP_STRM0 (GDCPRE)
98 GDC_SIGNA0 (GDCPRE)
99 GDC_DISP0_SYNC0 (GDCPRE)
100 GDC_DISP0_SYNC1 (GDCPRE)
101 GDC_CONT_STRM1 (GDCPRE)
102 GDC_SAFE_STRM1 (GDCPRE)
103 GDC_DISP_STRM1 (GDCPRE)
104 GDC_SIGNA1 (GDCPRE)
105 GDC_DISP1_SYNC0 (GDCPRE)
106 GDC_DISP1_SYNC1 (GDCPRE)
107 GDC_CAP_PLN0 (GDCPRE)
108 GDC_DISP_PLN0 (GDCPRE)
109 GDC_STRG_STRM0 (GDCPRE)
110 GDC_HISTGRM (GDCPRE)
112 DSTC_HW (DSTC)
117 PCRC_I2S0_1 (I2S0, I2S1, PCRC)
118 SD (SDIF)
119 FLASHIF (FLASH_IF)
120 GDC_HSSPI_RX (HSSPI)
121 GDC_HSSPI_TX (HSSPI)
122 GDC_HSSPI_FAULT (HSSPI)
123 GDC_HYPERBUS (HYPERBUS)

## Further device data
mcutype=4

## Notices in the file
Copyright (C) 2013-2016, Cypress Semiconductor Corporation or a
subsidiary of Cypress Semiconductor Corporation.  All rights reserved.
This software, including source code, documentation and related
materials ("Software"), is owned by Cypress Semiconductor Corporation or
one of its subsidiaries ("Cypress") and is protected by and subject to
worldwide patent protection (United States and foreign), United States
copyright laws and international treaty provisions. Therefore, you may use
this Software only as provided in the license agreement accompanying the
software package from which you obtained this Software ("EULA").
If no EULA applies, Cypress hereby grants you a personal, non-exclusive,
non-transferable license to copy, modify, and compile the
Software source code solely for use in connection with Cypress's
integrated circuit products.  Any reproduction, modification, translation,
compilation, or representation of this Software except as specified
above is prohibited without the express written permission of Cypress.
Disclaimer: THIS SOFTWARE IS PROVIDED AS-IS, WITH NO
WARRANTY OF ANY KIND, EXPRESS OR IMPLIED, INCLUDING,
BUT NOT LIMITED TO, NONINFRINGEMENT, IMPLIED
WARRANTIES OF MERCHANTABILITY AND FITNESS FOR A
PARTICULAR PURPOSE. Cypress reserves the right to make
changes to the Software without notice. Cypress does not assume any
liability arising out of the application or use of the Software or any
product or circuit described in the Software. Cypress does not
authorize its products for use in any products where a malfunction or
failure of the Cypress product may reasonably be expected to result in
significant property damage, injury or death ("High Risk Product"). By
including Cypress's product in a High Risk Product, the manufacturer
of such system or application assumes all risk of such use and in doing
so agrees to indemnify Cypress against all liability.
