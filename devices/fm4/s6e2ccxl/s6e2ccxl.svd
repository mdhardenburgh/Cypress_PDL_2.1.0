# S6E2CCxL register map
Vendor: Cypress; File version: 2.1
S6E2CC Series package L
CPU: CM4 r0p1, little endian, MPU, FPU, 4 interrupt priority bits
Registers are 32-bit, read-write, reset 0x0 unless marked. A register's access mark holds for its fields unless they carry their own. Offsets are from the block's base; lines under a group give offsets from that group; [hi:lo] are bit positions; {n}, {i} and the like mark numbered series; 'fields as' and 'values as' point back to an identical list; <NAME> marks a mode.

## Memory map
0x40000000 FLASH_IF blocks up to offset 0x120 — Flash Memory
0x40000200 UNIQUE_ID blocks up to offset 0x8
0x40000300 ECC_CAPTURE size 0x4 — ECC Capture Address
0x40000400 DUALFLASH_IF blocks up to offset 0xC — Dual Flash Memory
0x40010000 CRG blocks up to offset 0x78 — Clock Unit Registers
0x40011000 HWWDT blocks up to offset 0xC04 — Hardware Watchdog Timer
0x40012000 SWWDT blocks up to offset 0xC04 — Software Watchdog Timer
0x40015000 DT blocks up to offset 0x3C — Dual Timer
0x40020000 MFT0 blocks up to offset 0x1ED — Multifunction Timer 0
0x40021000 MFT1 blocks up to offset 0x1ED — Multifunction Timer 1
0x40022000 MFT2 blocks up to offset 0x1ED — Multifunction Timer 2
0x40024000 MFT_PPG blocks up to offset 0x359 — PPG Configuration
0x40025000 BT0 blocks up to offset 0x12 — Base Timer 0
0x40025040 BT1 blocks up to offset 0x12 — Base Timer 1
0x40025080 BT2 blocks up to offset 0x12 — Base Timer 2
0x400250C0 BT3 blocks up to offset 0x12 — Base Timer 3
0x40025100 BTIOSEL03 blocks up to offset 0x2 — Base Timer I/O Select
0x40025200 BT4 blocks up to offset 0x12 — Base Timer 4
0x40025240 BT5 blocks up to offset 0x12 — Base Timer 5
0x40025280 BT6 blocks up to offset 0x12 — Base Timer 6
0x400252C0 BT7 blocks up to offset 0x12 — Base Timer 7
0x40025300 BTIOSEL47 blocks up to offset 0x2 — Base Timer I/O Select
0x40025400 BT8 blocks up to offset 0x12 — Base Timer 8
0x40025440 BT9 blocks up to offset 0x12 — Base Timer 9
0x40025480 BT10 blocks up to offset 0x12 — Base Timer 10
0x400254C0 BT11 blocks up to offset 0x12 — Base Timer 11
0x40025500 BTIOSEL8B blocks up to offset 0x2 — Base Timer I/O Select
0x40025600 BT12 blocks up to offset 0x12 — Base Timer 12
0x40025640 BT13 blocks up to offset 0x12 — Base Timer 13
0x40025680 BT14 blocks up to offset 0x12 — Base Timer 14
0x400256C0 BT15 blocks up to offset 0x12 — Base Timer 15
0x40025700 BTIOSELCF blocks up to offset 0x2 — Base Timer I/O Select
0x40025F00 SBSSR blocks up to offset 0xFE — Software-based Simultaneous Startup Register
0x40026000 QPRC0 blocks up to offset 0x40 — Quadrature Position/Revolution Counter 0
0x40026040 QPRC1 blocks up to offset 0x40 — Quadrature Position/Revolution Counter 1
0x40026080 QPRC2 blocks up to offset 0x40 — Quadrature Position/Revolution Counter 2
0x400260C0 QPRC3 blocks up to offset 0x40 — Quadrature Position/Revolution Counter 3
0x40026100 QPRC0_NF blocks up to offset 0x9 — Quadrature Position/Revolution Counter 0 Noise Filter
0x40026110 QPRC1_NF blocks up to offset 0x9 — Quadrature Position/Revolution Counter 1 Noise Filter
0x40026120 QPRC2_NF blocks up to offset 0x9 — Quadrature Position/Revolution Counter 2 Noise Filter
0x40026130 QPRC3_NF blocks up to offset 0x9 — Quadrature Position/Revolution Counter 3 Noise Filter
0x40027000 ADC0 blocks up to offset 0x54 — ADC0 Registers
0x40027100 ADC1 blocks up to offset 0x54 — ADC1 Registers
0x40027200 ADC2 blocks up to offset 0x54 — ADC2 Registers
0x4002E000 CRTRIM blocks up to offset 0x10 — CR Trimming Registers
0x40030000 EXTI blocks up to offset 0x1A — External Interrupt and NMI Control
0x40031000 INTREQ blocks up to offset 0x404 — Interrupts
0x40033000 DAC0 blocks up to offset 0x6 — D/A Converter 0
0x40033008 DAC1 blocks up to offset 0x6 — D/A Converter 1
0x40035000 LVD blocks up to offset 0x11 — Low-voltage Detection
0x40035100 DS blocks up to offset 0x810 — Low Power Consumption Mode
0x40036000 USBETHERCLK blocks up to offset 0x35 — USB/Ethernet Clock
0x40037000 CANPRES size 0x1 — CAN Prescaler Register
{0x40038000+0x100*n} MFS{n} blocks up to offset 0x42 (n=0..15) — Multi-function Serial Interface {n}
0x40039000 CRC blocks up to offset 0x10 — CRC Registers
0x4003A000 WC blocks up to offset 0x15 — Watch Counter
0x4003B100 RTC blocks up to offset 0x180 — REAL-TIME CLOCK
0x4003C000 LSCRP size 0x1 — Low-speed CR Prescaler
0x4003C100 CLK_GATING blocks up to offset 0x28 — Peripheral Clock Gating
0x4003D000 I2SPRE size 0x28 — I2S Clock Generation
0x4003F000 EXBUS blocks up to offset 0x314 — External Bus Interface
0x40040000 USB0 blocks up to offset 0x2176 — USB0 Function
0x40052100 USB1 blocks up to offset 0x2176 — USB1 Function
0x40060000 DMAC blocks up to offset 0x90 — DMAC Registers
0x40061000 DSTC size 0xB0 — DSTC registers
0x40062000 CAN0 blocks up to offset 0xB4 — CAN0 Registers
0x40063000 CAN1 blocks up to offset 0xB4 — CAN1 Registers
0x40064000 ETHERNET_MAC0 blocks up to offset 0x1058
0x40066000 ETHERNET_CONTROL blocks up to offset 0xC — Ethernet system control
0x4006C000 I2S0 size 0x30 — I2S
0x4006E000 SDIF blocks up to offset 0x156 — SD Card Interface
0x4006F000 GPIO blocks up to offset 0x780
0x40070000 CANFD0 blocks up to offset 0x21C — CAN FD Registers
0x40080000 PCRC blocks up to offset 0x18 — 0
0xD0000000 HSSPI blocks up to offset 0x405 — HI-SPEED SPI Controller

## Interrupts
0 CSV (CRG)
1 SWDT (SWWDT)
2 LVD
{n} IRQ{n:03}SEL (INTREQ) (n=3..10)
{n+11} EXINT{n} (EXTI) (n=0..7)
19 QPRC0
20 QPRC1
21 MFT0_WFG_DTIF (MFT0)
22 MFT1_WFG_DTIF (MFT1)
23 MFT2_WFG_DTIF (MFT2)
24 MFT0_FRT_PEAK (MFT0)
25 MFT0_FRT_ZERO (MFT0)
26 MFT0_ICU (MFT0)
27 MFT0_OCU (MFT0)
28 MFT1_FRT_PEAK (MFT1)
29 MFT1_FRT_ZERO (MFT1)
30 MFT1_ICU (MFT1)
31 MFT1_OCU (MFT1)
32 MFT2_FRT_PEAK (MFT2)
33 MFT2_FRT_ZERO (MFT2)
34 MFT2_ICU (MFT2)
35 MFT2_OCU (MFT2)
36 PPG00_02_04 (MFT_PPG)
37 PPG08_10_12 (MFT_PPG)
38 PPG16_18_20 (MFT_PPG)
{n+39} BT{n} (n=0..7)
47 DT
48 WC
49 EXTBUS_ERR (EXBUS)
50 RTC
{n+43} EXINT{n} (EXTI) (n=8..15)
59 TIM (CRG, I2SPRE)
{2n+60} MFS{n}_RX (MFS{n}) (n=0..7)
{2n+61} MFS{n}_TX (MFS{n}) (n=0..7)
76 ADC0
77 ADC1
78 USB0_F (USB0)
79 USB0_H_F (USB0)
80 CAN0
81 CAN1_CANFD0 (CAN1, CANFD0)
82 ETHER0 (ETHERNET_MAC0)
{n+83} DMAC{n} (DMAC) (n=0..7)
91 DSTC
92 EXINT16_19 (EXTI)
93 EXINT20_23 (EXTI)
94 EXINT24_27 (EXTI)
95 EXINT28_31 (EXTI)
96 QPRC2
97 QPRC3
98 BT8
99 BT9
100 BT10
101 BT11
102 BT12_15 (BT12)
103 MFS8_RX (MFS8)
104 MFS8_TX (MFS8)
105 MFS9_RX (MFS9)
106 MFS9_TX (MFS9)
107 MFS10_RX (MFS10)
108 MFS10_TX (MFS10)
109 MFS11_RX (MFS11)
110 MFS11_TX (MFS11)
111 ADC2
112 DSTC_HW (DSTC)
113 USB1_F (USB1)
114 USB1_H_F (USB1)
115 HSSPI
117 PCRC_I2S0_1 (I2S0, PCRC)
118 SD (SDIF)
119 FLASHIF (FLASH_IF)
120 MFS12_RX (MFS12)
121 MFS12_TX (MFS12)
122 MFS13_RX (MFS13)
123 MFS13_TX (MFS13)
124 MFS14_RX (MFS14)
125 MFS14_TX (MFS14)
126 MFS15_RX (MFS15)
127 MFS15_TX (MFS15)

## Further device data
mcutype=3

## Notices in the file
Copyright (C) 2013-2016, Cypress Semiconductor Corporation or a
subsidiary of Cypress Semiconductor Corporation.  All rights reserved.
This software, including source code, documentation and related
materials ("Software"), is owned by Cypress Semiconductor Corporation or
one of its subsidiaries ("Cypress") and is protected by and subject to
worldwide patent protection (United States and foreign), United States
copyright laws and international treaty provisions. Therefore, you may use
this Software only as provided in the license agreement accompanying the
software package from which you obtained this Software ("EULA").
If no EULA applies, Cypress hereby grants you a personal, non-exclusive,
non-transferable license to copy, modify, and compile the
Software source code solely for use in connection with Cypress's
integrated circuit products.  Any reproduction, modification, translation,
compilation, or representation of this Software except as specified
above is prohibited without the express written permission of Cypress.
Disclaimer: THIS SOFTWARE IS PROVIDED AS-IS, WITH NO
WARRANTY OF ANY KIND, EXPRESS OR IMPLIED, INCLUDING,
BUT NOT LIMITED TO, NONINFRINGEMENT, IMPLIED
WARRANTIES OF MERCHANTABILITY AND FITNESS FOR A
PARTICULAR PURPOSE. Cypress reserves the right to make
changes to the Software without notice. Cypress does not assume any
liability arising out of the application or use of the Software or any
product or circuit described in the Software. Cypress does not
authorize its products for use in any products where a malfunction or
failure of the Cypress product may reasonably be expected to result in
significant property damage, injury or death ("High Risk Product"). By
including Cypress's product in a High Risk Product, the manufacturer
of such system or application assumes all risk of such use and in doing
so agrees to indemnify Cypress against all liability.
